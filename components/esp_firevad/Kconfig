## components/esp_firevad/Kconfig
```kconfig
menu "ESP FireVAD Configuration"

    choice FIREVAD_LOG_MODE
        bool "Performance logging mode"
        default FIREVAD_LOG_DISABLED
        help
            Control per-frame performance logging behavior.
            
            - DISABLED: No performance logs (production default)
            - RATE_LIMITED: Periodic logs with configurable rate (safe for debugging)
            - FULL: Log every frame (WARNING: can cause watchdog timeout!)
        
        config FIREVAD_LOG_DISABLED
            bool "Disabled (production)"
            help
                No performance logging. Maximum system stability and performance.
                Recommended for production use.
        
        config FIREVAD_LOG_RATE_LIMITED
            bool "Rate-limited (safe debugging)"
            help
                Log performance metrics at a reduced rate (configurable below).
                Safe for extended debugging without system instability.
                Recommended for performance analysis.
        
        config FIREVAD_LOG_FULL
            bool "Full per-frame (DANGEROUS - testing only!)"
            help
                Log every 10ms frame (~100 logs/second).
                
                WARNING: This WILL cause:
                - UART TX buffer overflow at 115200 baud
                - Task watchdog timeout after ~7 seconds
                - System crash
                
                Only use with:
                - High baudrate (921600+)
                - Short test duration (<5 seconds)
                - UART flow control enabled
    endchoice

    config FIREVAD_LOG_RATE_DIVIDER
        int "Log rate divider (frames between logs)"
        depends on FIREVAD_LOG_RATE_LIMITED
        range 1 1000
        default 100
        help
            Number of frames to skip between performance logs.
            
            Examples (at 10ms frame rate):
            - 10 = 10 logs/second (very verbose, watch for buffer overflow)
            - 50 = 2 logs/second (good for detailed analysis)
            - 100 = 1 log/second (recommended default)
            - 200 = 0.5 logs/second (conservative)
            
            Lower values = more logs = higher risk of UART overflow.
            Increase baudrate to 921600 if using values <50.

endmenu
```

## examples/console_vad/main/Kconfig.projbuild
```kconfig
menu "FireVAD Audio Configuration"

    config FIREVAD_ENABLE_AUDIO
        bool "Enable Audio Input (Microphone)"
        default n
        help
            Enable audio input support via I2S codec (e.g., ES8311).
            When disabled, only file-based VAD testing is available.

    menu "ES8311 Codec Configuration"
        depends on FIREVAD_ENABLE_AUDIO

        config FIREVAD_I2C_SCL_GPIO
            int "I2C SCL GPIO"
            default 8
            range 0 54
            help
                GPIO pin for I2C clock line (SCL) to communicate with ES8311.
                Default: GPIO8 (Waveshare ESP32-P4-WIFI6)

        config FIREVAD_I2C_SDA_GPIO
            int "I2C SDA GPIO"
            default 7
            range 0 54
            help
                GPIO pin for I2C data line (SDA) to communicate with ES8311.
                Default: GPIO7 (Waveshare ESP32-P4-WIFI6)

        config FIREVAD_I2C_FREQ_HZ
            int "I2C Frequency (Hz)"
            default 400000
            help
                I2C bus frequency for ES8311 communication.
                Default: 400kHz (fast mode)

        config FIREVAD_I2S_MCLK_GPIO
            int "I2S Master Clock GPIO"
            default 13
            range 0 54
            help
                GPIO pin for I2S master clock (MCLK).
                Default: GPIO13

        config FIREVAD_I2S_BCLK_GPIO
            int "I2S Bit Clock GPIO"
            default 12
            range 0 54
            help
                GPIO pin for I2S bit clock (BCLK).
                Default: GPIO12

        config FIREVAD_I2S_WS_GPIO
            int "I2S Word Select GPIO"
            default 10
            range 0 54
            help
                GPIO pin for I2S word select / left-right clock (WS/LRCK).
                Default: GPIO10

        config FIREVAD_I2S_DIN_GPIO
            int "I2S Data In GPIO (Microphone)"
            default 11
            range 0 54
            help
                GPIO pin for I2S data input from microphone.
                Default: GPIO11

        config FIREVAD_I2S_DOUT_GPIO
            int "I2S Data Out GPIO (Speaker)"
            default 9
            range 0 54
            help
                GPIO pin for I2S data output to speaker (optional).
                Default: GPIO9

        config FIREVAD_PA_PIN_GPIO
            int "Power Amplifier Enable GPIO"
            default 53
            range -1 54
            help
                GPIO pin to enable power amplifier (PA).
                Set to -1 to disable PA control.
                Default: GPIO53

    endmenu

    menu "Audio Parameters"
        depends on FIREVAD_ENABLE_AUDIO

        config FIREVAD_SAMPLE_RATE
            int "Sample Rate (Hz)"
            default 16000
            help
                Audio sample rate. Must be 16000 Hz for FireVAD models.

        config FIREVAD_BITS_PER_SAMPLE
            int "Bits Per Sample"
            default 16
            range 16 32
            help
                Audio bit depth. Must be 16 for FireVAD models.

        config FIREVAD_MIC_GAIN
            int "Default Microphone Gain (0-11)"
            default 6
            range 0 11
            help
                Default ES8311 microphone gain level.
                0 = 0dB (minimum), 11 = 24dB (maximum)
                Adjustable at runtime via 'gain -h' command.

        config FIREVAD_SPEAKER_VOL
            int "Default Speaker Volume (0-100)"
            default 50
            range 0 100
            help
                Default ES8311 speaker volume level (percentage).
                Adjustable at runtime via 'speaker_vol' command.

        config FIREVAD_BUFFER_SIZE
            int "Audio Buffer Size (samples)"
            default 1600
            help
                Number of samples per I2S buffer (must be multiple of 160).
                Larger = more latency, smaller = more interrupts.
                Default: 1600 (10 frames = 100ms @ 16kHz)

    endmenu

endmenu
```

## examples/console_vad/sdkconfig.defaults
```kconfig
# ============================================================================
# ESP32-P4 Hardware Target Configuration
# ============================================================================
CONFIG_IDF_TARGET="esp32p4"
CONFIG_ESP32P4_SELECTS_REV_LESS_V3=y

# ============================================================================
# Flash Configuration (32 MB QIO Mode)
# ============================================================================
CONFIG_ESPTOOLPY_FLASHMODE_QIO=y
CONFIG_ESPTOOLPY_FLASHSIZE_32MB=y

# ============================================================================
# Partition Table
# ============================================================================
CONFIG_PARTITION_TABLE_CUSTOM=y
CONFIG_PARTITION_TABLE_CUSTOM_FILENAME="partitions.csv"
CONFIG_PARTITION_TABLE_FILENAME="partitions.csv"

# ============================================================================
# PSRAM Configuration (Required for FireVAD models)
# ============================================================================
CONFIG_SPIRAM=y
CONFIG_SPIRAM_USE_MALLOC=y

# ============================================================================
# SPIFFS Configuration (16MB partition requires larger page size)
# ============================================================================
CONFIG_SPIFFS_MAX_PARTITIONS=3
CONFIG_SPIFFS_PAGE_SIZE=512
CONFIG_SPIFFS_OBJ_NAME_LEN=64
CONFIG_SPIFFS_USE_MAGIC=y
CONFIG_SPIFFS_USE_MAGIC_LENGTH=y

# ============================================================================
# FreeRTOS Configuration
# ============================================================================
CONFIG_FREERTOS_HZ=1000
CONFIG_ESP_TASK_WDT_TIMEOUT_S=10

# ============================================================================
# Console/UART Configuration
# ============================================================================
CONFIG_ESP_CONSOLE_UART_NUM=0
CONFIG_ESP_CONSOLE_UART_BAUDRATE=115200

# ============================================================================
# Logging Configuration
# ============================================================================
CONFIG_LOG_DEFAULT_LEVEL_INFO=y
CONFIG_LOG_MAXIMUM_LEVEL_VERBOSE=y

# ============================================================================
# I2S Configuration
# ============================================================================
CONFIG_I2S_ENABLE_DEBUG_LOG=n

# ============================================================================
# FireVAD Component Configuration
# ============================================================================
CONFIG_FIREVAD_ENABLE_AUDIO=y

# ============================================================================
# ESP-DSP Optimization (CRITICAL: Enable PIE/SIMD acceleration!)
# ============================================================================
CONFIG_DSP_ANSI=n
CONFIG_DSP_OPTIMIZED=y

# ============================================================================
# Compiler Optimization (CRITICAL for Performance!)
# ============================================================================
CONFIG_COMPILER_OPTIMIZATION_PERF=y
CONFIG_COMPILER_OPTIMIZATION_ASSERTIONS_DISABLE=y

# ============================================================================
# Power Management
# ============================================================================
CONFIG_PM_ENABLE=y
```
